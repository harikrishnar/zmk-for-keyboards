## config/west.yml
```yaml
manifest:
  remotes:
    - name: zmkfirmware
      url-base: https://github.com/zmkfirmware
    - name: petejohanson
      url-base: https://github.com/petejohanson
    - name: mctechnology17
      url-base: https://github.com/mctechnology17
    - name: m165437
      url-base: https://github.com/M165437
    - name: infely
      url-base: https://github.com/infely
    - name: harikrishnar
      url-base: https://github.com/harikrishnar
  projects:
    - name: zmk
      remote: zmkfirmware
      revision: v0.3
      import: app/west.yml
    - name: zmk-nice-oled
      remote: harikrishnar
      revision: hari-v0.3
  self:
    path: config
```
